## bootable/kernel-source/lenovo/a6000/Kconfig
```kconfig
mainmenu "MyLinux Kernel Configuration - Lenovo A6000"

config MYLINUX_KERNEL
    bool
    default y

menu "General setup"

config LOCALVERSION
    string "Local version"
    default "-mylinux-a6000"

config LOCALVERSION_AUTO
    bool "Automatically append version information"
    default n

config 64BIT
    bool
    default n

config ARM
    bool
    default y

config SMP
    bool "Symmetric multiprocessing"
    default y

config NR_CPUS
    int "Maximum number of CPUs"
    range 1 4
    default 4

config HZ
    int "Timer frequency"
    range 100 1000
    default 250

config PRINTK
    bool "Enable kernel printk"
    default y

config IKCONFIG
    bool "Enable embedded kernel configuration"
    default y

config IKCONFIG_PROC
    bool "Expose kernel configuration through /proc/config.gz"
    depends on IKCONFIG
    default y

endmenu

menu "Memory management"

config MMU
    bool
    default y

config SWAP
    bool "Enable swap support"
    default y

config MEMORY_HOTPLUG
    bool "Memory hotplug support"
    default n

endmenu

menu "Executable formats"

config BINFMT_ELF
    bool "ELF executable support"
    default y

config BINFMT_SCRIPT
    bool "Script execution support"
    default y

endmenu

menu "Device drivers"

source "drivers/Kconfig"

endmenu

menu "File systems"

source "fs/Kconfig"

endmenu

menu "Networking"

source "net/Kconfig"

endmenu

menu "Security"

source "security/Kconfig"

endmenu

menu "Cryptographic API"

source "crypto/Kconfig"

endmenu

menu "Architecture configuration"

source "arch/arm/Kconfig"

endmenu
```

## bootable/kernel-source/samsung/gto/Kconfig
```kconfig
mainmenu "MyLinux Kernel Configuration"

# Core architecture
config MYLINUX
    bool "MyLinux kernel"
    default y
    help
      Enable the MyLinux kernel project configuration.

config MYLINUX_VERSION
    string "MyLinux kernel version"
    default "0.1.0"

config LOCALVERSION
    string "Local kernel version suffix"
    default "-mylinux"

config EXPERT
    bool "Expert configuration"
    default y

# Target architecture
menu "Architecture Configuration"

choice
    prompt "Target architecture"
    default MYLINUX_ARCH_ARM64

config MYLINUX_ARCH_ARM64
    bool "ARM64 (AArch64)"

config MYLINUX_ARCH_GENERIC
    bool "Generic architecture prototype"

endchoice

config MYLINUX_SMP
    bool "Symmetric multiprocessing"
    default y

config MYLINUX_MMU
    bool "Memory management unit"
    default y

config MYLINUX_DEVICE_TREE
    bool "Device tree support"
    default y

endmenu

# Qualcomm platform
menu "Qualcomm Platform Configuration"

choice
    prompt "Qualcomm SoC family"
    default MYLINUX_SOC_MSM8937

config MYLINUX_SOC_MSM8937
    bool "MSM8937 family"

config MYLINUX_SOC_GENERIC
    bool "Generic Qualcomm platform"

endchoice

config MYLINUX_QCOM_UART
    bool "Qualcomm UART support"
    depends on MYLINUX_SOC_MSM8937
    default y

config MYLINUX_QCOM_CLOCK
    bool "Qualcomm clock integration"
    depends on MYLINUX_SOC_MSM8937
    default n

config MYLINUX_QCOM_PINCTRL
    bool "Qualcomm pin control integration"
    depends on MYLINUX_SOC_MSM8937
    default n

endmenu

# Memory management
menu "Memory Management"

config MYLINUX_MEMORY
    bool "Memory management"
    default y

config MYLINUX_VIRTUAL_MEMORY
    bool "Virtual memory"
    depends on MYLINUX_MEMORY
    default y

config MYLINUX_ALLOCATOR
    bool "Kernel memory allocator"
    depends on MYLINUX_MEMORY
    default y

config MYLINUX_CMA
    bool "Contiguous memory allocation"
    depends on MYLINUX_MEMORY
    default n

endmenu

# Kernel facilities
menu "Kernel Facilities"

config MYLINUX_PRINTK
    bool "Kernel logging"
    default y

config MYLINUX_EARLY_CONSOLE
    bool "Early console"
    depends on MYLINUX_PRINTK
    default y

config MYLINUX_PANIC
    bool "Kernel panic handling"
    default y

config MYLINUX_TRACE
    bool "Kernel tracing"
    default n

config MYLINUX_MODULES
    bool "Loadable kernel modules"
    default n

endmenu

# Storage
menu "Storage and Filesystems"

config MYLINUX_BLOCK
    bool "Block device support"
    default y

config MYLINUX_PARTITIONS
    bool "Partition table parsing"
    depends on MYLINUX_BLOCK
    default y

config MYLINUX_EXT4
    bool "EXT4 filesystem integration"
    default y

config MYLINUX_F2FS
    bool "F2FS filesystem integration"
    default n

config MYLINUX_EROFS
    bool "EROFS read-only filesystem integration"
    default y

config MYLINUX_TMPFS
    bool "Temporary filesystem integration"
    default y

endmenu

# Networking
menu "Networking"

config MYLINUX_NETWORK
    bool "Network subsystem"
    default y

config MYLINUX_IPV4
    bool "IPv4 networking"
    depends on MYLINUX_NETWORK
    default y

config MYLINUX_IPV6
    bool "IPv6 networking"
    depends on MYLINUX_NETWORK
    default y

config MYLINUX_WIFI
    bool "Wi-Fi integration"
    depends on MYLINUX_NETWORK
    default n

endmenu

# Security
menu "Security"

config MYLINUX_SECURITY
    bool "Kernel security interfaces"
    default y

config MYLINUX_SELINUX
    bool "SELinux integration"
    depends on MYLINUX_SECURITY
    default n

config MYLINUX_MODULE_SIGNATURES
    bool "Module signature verification"
    depends on MYLINUX_MODULES
    default n

endmenu

# Device drivers
menu "Device Drivers"

config MYLINUX_SERIAL
    bool "Serial device support"
    default y

config MYLINUX_GPIO
    bool "GPIO support"
    default n

config MYLINUX_I2C
    bool "I2C support"
    default n

config MYLINUX_SPI
    bool "SPI support"
    default n

config MYLINUX_USB
    bool "USB support"
    default n

config MYLINUX_THERMAL
    bool "Thermal monitoring"
    default n

config MYLINUX_POWER
    bool "Power management integration"
    default n

endmenu

# Debugging
menu "Debugging"

config MYLINUX_DEBUG
    bool "Kernel debugging"
    default y

config MYLINUX_DEBUG_MEMORY
    bool "Memory diagnostics"
    depends on MYLINUX_DEBUG
    default n

config MYLINUX_DEBUG_LOCKS
    bool "Lock diagnostics"
    depends on MYLINUX_DEBUG
    default n

config MYLINUX_DEBUG_BOOT
    bool "Boot diagnostics"
    depends on MYLINUX_DEBUG
    default y

endmenu
```
